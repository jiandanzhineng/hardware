## components/base_device/Kconfig
```kconfig
menu "Device Selectionaaaaaaaaaaaaaaaaaaaaaaaaaaaaaaaaaaaaaaaaaaaaaaaaaaaaa"
    
	choice DEVICE_SELECTION
	    prompt "Device Selection"
	    default DEVICE_QTZ
	    help
	        This is a help.
	
	    config DEVICE_TD01
	        bool "TD01"
	        help
	            help for option1
	            
	    config DEVICE_TJS
	        bool "TJS"
	        help
	        	help for option2

		config DEVICE_DIANJI
	        bool "DIANJI"
	        help
	        	help for option3

		config DEVICE_QTZ
			bool "QTZ"
			help
				help for option4

		config DEVICE_ZIDONGSUO
			bool "ZIDONGSUO"
			help
				help for option5

		config DEVICE_PJ01
			bool "PJ01"
			help
				PJ01 PWM motor control device
	endchoice

endmenu
  
```

## components/ota_update/Kconfig
```kconfig
menu "OTA Configuration"

    config OTA_SERVER_URL
        string "Firmware Update Server URL"
        default "http://192.168.1.100:8000"
        help
            Base URL where version.json and firmware.bin are hosted.
            Example: http://myserver.com/ota

    config OTA_CHECK_INTERVAL_SEC
        int "Auto Check Interval (seconds)"
        default 86400
        help
            How often to check for updates automatically (in seconds).
            Default is 24 hours (86400).

endmenu
```

## sdkconfig.defaults
```kconfig
# Override some defaults so BT stack is enabled
# in this example

#
# Serial Flasher Config
#
CONFIG_ESPTOOLPY_FLASHSIZE_4MB=y

#
# Partition Table
# Use Custom Partition Table
CONFIG_PARTITION_TABLE_CUSTOM=y
CONFIG_PARTITION_TABLE_CUSTOM_FILENAME="partitions.csv"
# CONFIG_PARTITION_TABLE_TWO_OTA is not set
# CONFIG_PARTITION_TABLE_SINGLE_APP_LARGE is not set

# OTA Config
CONFIG_BOOTLOADER_APP_ROLLBACK_ENABLE=y
CONFIG_APP_UPDATE_CHECK_APP_VALIDITY=y
CONFIG_ESP_HTTPS_OTA_ALLOW_HTTP=y

#
# BT config
#
CONFIG_BT_ENABLED=y
CONFIG_BT_GATTC_ENABLE=n
CONFIG_BT_BLE_SMP_ENABLE=n
CONFIG_BT_BLE_BLUFI_ENABLE=y
CONFIG_MBEDTLS_HARDWARE_MPI=n
CONFIG_MBEDTLS_DHM_C=y
```
