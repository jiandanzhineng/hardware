## tests/sk_board/main/Kconfig.projbuild
```kconfig
menu "SK board diagnostics"
    config SK_LOCK_OUTPUT_ENABLED
        bool "Enable lock output for bench testing"
        default y
        help
            Enables manually armed, bounded lock pulses for bench testing.
            This option does not indicate that the hardware is verified.
            The supplied V1.0 schematic connects GPIO3 directly to a PMOS
            gate pulled up to VBAT and shows no coil flyback protection.
            Software cannot guarantee physical cutoff on that interface.
            The 1000ms limit, 10s cooldown and manual arming remain active.
    config SK_LOCK_ACTIVE_LOW
        bool "Lock driver is active LOW"
        depends on SK_LOCK_OUTPUT_ENABLED
        default y
        help
            Matches the original V1.0 PMOS gate interface. An added NPN
            driving the PMOS gate
            usually makes the MCU signal active HIGH; disable in that case.
    config SK_POWER_HOLD_PUSH_PULL
        bool "Q1 base series resistor has been fitted: use push-pull hold"
        default n
        help
            V1.0 connects GPIO1 straight to Q1 base. Default uses open-drain
            release with internal pull-up to limit base current. Its ability
            to retain power needs measurement. Enable only with a proper
            external base series resistor.
endmenu
```

## tests/sk_board/sdkconfig.defaults
```kconfig
CONFIG_IDF_TARGET="esp32c3"
CONFIG_ESPTOOLPY_FLASHSIZE_4MB=y
CONFIG_ESP_CONSOLE_USB_SERIAL_JTAG=y
CONFIG_ESP_CONSOLE_SECONDARY_NONE=y
CONFIG_ESP_CONSOLE_UART_BAUDRATE=115200
CONFIG_GPIO_CTRL_FUNC_IN_IRAM=y
CONFIG_GPTIMER_ISR_IRAM_SAFE=y
CONFIG_GPTIMER_CTRL_FUNC_IN_IRAM=y
CONFIG_ESP_SYSTEM_PANIC_PRINT_REBOOT=y
CONFIG_ESP_TASK_WDT_EN=y
CONFIG_ESP_TASK_WDT_INIT=y
CONFIG_ESP_TASK_WDT_PANIC=y
CONFIG_ESP_TASK_WDT_TIMEOUT_S=5
CONFIG_FREERTOS_HZ=1000
CONFIG_ESP_MAIN_TASK_STACK_SIZE=8192
CONFIG_LOG_DEFAULT_LEVEL_INFO=y
# CONFIG_LOG_COLORS is not set
CONFIG_SK_LOCK_OUTPUT_ENABLED=y
CONFIG_SK_LOCK_ACTIVE_LOW=y
```

## tests/sk_board/sdkconfig.defaults.uart
```kconfig
CONFIG_ESP_CONSOLE_UART_DEFAULT=y
CONFIG_ESP_CONSOLE_SECONDARY_NONE=y
CONFIG_ESP_CONSOLE_UART_BAUDRATE=115200
```
